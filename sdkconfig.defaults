## sdkconfig.defaults
```kconfig
# Target: ESP32-C3
CONFIG_IDF_TARGET="esp32c3"

# WiFi
CONFIG_ESP_WIFI_SOFTAP_SUPPORT=y

# UART
CONFIG_ESP_CONSOLE_USB_SERIAL_JTAG=y

# Partition table
CONFIG_PARTITION_TABLE_SINGLE_APP=y

# Log level
CONFIG_LOG_DEFAULT_LEVEL_INFO=y

# HTTP client
CONFIG_ESP_HTTP_CLIENT_ENABLE_HTTPS=n
```
